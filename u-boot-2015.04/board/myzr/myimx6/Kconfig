## u-boot-2015.04/board/myzr/myimx6/Kconfig
```kconfig
config SYS_BOARD
	default "myimx6"

config SYS_VENDOR
	default "myzr"

config SYS_SOC
	default "mx6"

config SYS_CONFIG_NAME
	default "myimx6"
```

## u-boot-2015.04/configs/myimx6ek200-6s_defconfig
```kconfig
CONFIG_SYS_EXTRA_OPTIONS="IMX_CONFIG=board/myzr/myimx6/myimx6.cfg,MX6SOLO,DDR_MB=512,SYS_NOSMP=\"nosmp\""
CONFIG_ARM=y
CONFIG_TARGET_MYIMX6EK200=y
CONFIG_SYS_MALLOC_F=y
CONFIG_SYS_MALLOC_F_LEN=0x400
CONFIG_DM=y
CONFIG_DM_THERMAL=y
```

## u-boot-2015.04/configs/myimx6ek314-6q-2g_defconfig
```kconfig
CONFIG_SYS_EXTRA_OPTIONS="IMX_CONFIG=board/myzr/myimx6/myimx6.cfg,MX6Q,DDR_MB=2048"
CONFIG_ARM=y
CONFIG_TARGET_MYIMX6EK314=y
CONFIG_DM=y
CONFIG_DM_THERMAL=y
```
